## br2-external/linear_function_accelerator/Config.in
```kconfig
config BR2_PACKAGE_LINEAR_FUNCTION_ACCELERATOR
  bool "linear_function_accelerator"
    depends on BR2_LINUX_KERNEL
    help
      Kernel driver for a custom peripheral.
```

## br2-external/my-custom-peripheral/Config.in
```kconfig
config BR2_PACKAGE_MY_CUSTOM_PERIPHERAL
    bool "my-custom-peripheral"
    depends on BR2_LINUX_KERNEL
    help
      Kernel driver for a custom peripheral.
```
